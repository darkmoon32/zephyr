## boards/laskakit/espink/Kconfig.espink
```kconfig
# Copyright (c) 2023 Espressif Systems (Shanghai) Co., Ltd.
# SPDX-License-Identifier: Apache-2.0

config BOARD_ESPINK
	select SOC_ESP32_WROOM_32UE_N16
	select SOC_ESP32_PROCPU if BOARD_ESPINK_ESP32_PROCPU
	select SOC_ESP32_APPCPU if BOARD_ESPINK_ESP32_APPCPU
```
